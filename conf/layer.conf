## conf/layer.conf
```bitbake
# We have a conf and classes directory, add to BBPATH
BBPATH .= ":${LAYERDIR}"

# We have a packages directory, add to BBFILES
BBFILES += "${LAYERDIR}/recipes-*/*/*.bb \
            ${LAYERDIR}/recipes-*/*/*.bbappend"

BBFILE_COLLECTIONS += "modbas-udooneo"
BBFILE_PATTERN_modbas-udooneo := "^${LAYERDIR}/"
BBFILE_PRIORITY_modbas-udooneo = "10"

LAYERDEPENDS_modbas-udooneo = "core meta-udoo"
```
